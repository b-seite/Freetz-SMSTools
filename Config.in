## Config.in
```kconfig
config FREETZ_PACKAGE_SMSTOOLS3
	bool "SMS Tools3 3.1.14"
	
	default n
	help
		The SMS Server Tools 3 is a SMS Gateway software which can send and receive short messages through GSM modems and mobile phones.
```
